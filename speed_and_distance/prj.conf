## CMakeLists.txt
```
# Copyright (c) 2026 Semtech Corporation
# SPDX-License-Identifier: Apache-2.0
#
# Adapted from flrc_throughput/CMakeLists.txt (adds the ranging module).

cmake_minimum_required(VERSION 3.13.1)

find_package(Zephyr REQUIRED HINTS $ENV{ZEPHYR_BASE})
project(speed_and_distance)

target_include_directories(app PRIVATE
    src
    src/oled_display
)

file(GLOB OLED_DISPLAY src/oled_display/*.c)

target_sources(app PRIVATE
    ${OLED_DISPLAY}
    src/app_flrc.c
    src/app_ranging.c
    src/main.c
)
```

## Kconfig
```
# Copyright (c) 2026 Semtech Corporation
# SPDX-License-Identifier: Apache-2.0
#
# Adapted from flrc_throughput/Kconfig (role choice, FLRC settings) plus phase and ranging settings.
# Every frequency here is limited to the 2.4 GHz ISM band. The sub-GHz antenna is a CN490 part:
# never transmit below 2400 MHz on this bench. app_radio_limits.h re-checks this at compile time.

menu "Speed and distance demo"

choice APP_ROLE
	prompt "Device role"
	default APP_ROLE_TX
	help
	  TX: FLRC transmitter in the SPEED phase, ranging subordinate in the DISTANCE phase,
	  and the phase master (it owns the phase timer).
	  RX: FLRC receiver in the SPEED phase, ranging manager (computes the distance) in the
	  DISTANCE phase. Build RX with -DCONFIG_APP_ROLE_RX=y.

config APP_ROLE_TX
	bool "Transmitter / ranging subordinate / phase master"

config APP_ROLE_RX
	bool "Receiver / ranging manager"

endchoice # APP_ROLE

# ------------------------------------------------------------------ phases

config APP_SPEED_PHASE_MS
	int "SPEED (FLRC throughput) phase length in ms"
	default 5000
	range 2000 60000

config APP_DISTANCE_PHASE_MS
	int "DISTANCE (LoRa ranging) phase length in ms"
	default 5000
	range 2000 60000

config APP_SWITCH_WARN_MS
	int "TX sets the mode-switch flag in FLRC packets this long before the switch (ms)"
	default 100
	range 20 1000

config APP_RX_FALLBACK_MS
	int "RX switches to DISTANCE on its own after this long without FLRC packets (ms)"
	default 1000
	range 200 5000

# ------------------------------------------------------------------ FLRC

config APP_RF_FREQ_MHZ
	int "FLRC RF frequency in MHz"
	default 2440
	range 2401 2482
	help
	  2.4 GHz ISM only. >= 1500 MHz selects the LR2021 HF (2.4 GHz) RX path and HF PA.

config APP_TX_POWER_DBM
	int "TX power in dBm (FLRC and ranging)"
	default 5
	range -17 12
	help
	  The LR2021 HF PA range is -17..+12 dBm (usp_zephyr lr20xx_ral_bsp_calibration.c).

config APP_PAYLOAD_SIZE
	int "FLRC payload size in bytes"
	default 511
	range 8 511
	help
	  LR20xx FLRC payload range is 6..511 bytes. The first 8 bytes carry the header
	  (sequence number, flags, ms to switch, cycle).

config APP_TX_PIPELINE
	bool "Pre-load the next TX payload in the radio FIFO while the current one is on air"
	default y
	help
	  Needs 2 x APP_PAYLOAD_SIZE <= 1024 (LR20xx extended TX FIFO).

config APP_SEQ_RESYNC_GAP
	int "Largest sequence jump counted as lost packets"
	default 10000

# ------------------------------------------------------------------ ranging

config APP_RANGING_CFG_FREQ_MHZ
	int "Frequency of the ranging config / ack LoRa packets in MHz"
	default 2440
	range 2402 2480
	help
	  The RTToF exchanges hop over the stock "2G4" table (2402..2480 MHz).

config APP_RANGING_SF
	int "LoRa spreading factor for ranging"
	default 5
	range 5 10
	help
	  SF5..SF10 have calibrated delay indicators at 812 kHz above 2 GHz.

config APP_RANGING_EXTRA_DELAY_MS
	int "Extra time added to each RTToF exchange slot (ms)"
	default 0
	range 0 100
	help
	  Stock slot = 64.25 symbols + 20 ms processing (22 ms at SF5 / 812 kHz).

config APP_RANGING_RSSI_WINDOW_DB
	int "Drop hops more than this many dB below the strongest hop of the run"
	default 100
	range 1 100
	help
	  100 (default) keeps every valid hop. On the bench at 1.9 m a 10 dB window made the
	  result worse: the strongest hops (2458-2480 MHz) were also the most biased, and only
	  about half the hops were left for the median.

config APP_RANGING_OFFSET_CM
	int "Distance offset subtracted from every run (cm)"
	default 0
	help
	  Bench calibration: place the boards at a known distance, read the smoothed distance,
	  and set the difference here.

config APP_RANGING_SMOOTH_RUNS
	int "RX display: median of the last N run results"
	default 5
	range 1 15

endmenu

source "Kconfig.zephyr"
```

## prj.conf
```kconfig
# Copyright (c) 2026 Semtech Corporation
# SPDX-License-Identifier: Apache-2.0
#
# Copied from flrc_throughput/prj.conf (itself adapted from swdm031_img_xfer prj.conf).

# --------------------------- General configuration ---------------------------

CONFIG_SPEED_OPTIMIZATIONS=y

CONFIG_ICACHE=y

CONFIG_USE_SEGGER_RTT=n
CONFIG_HEAP_MEM_POOL_SIZE=4096
CONFIG_LOG=y
CONFIG_LOG_BUFFER_SIZE=4096
CONFIG_PRINTK=y

CONFIG_TEST_RANDOM_GENERATOR=y
CONFIG_PM_DEVICE=y
CONFIG_WATCHDOG=n
CONFIG_FLASH=y

CONFIG_MAIN_STACK_SIZE=4096
CONFIG_STACK_SENTINEL=y
CONFIG_THREAD_NAME=y

# ------------------------------ Transceiver driver ----------------------------

CONFIG_LORA_BASICS_MODEM_DRIVERS=y
# IRQ handled without the global work-queue hop (lower latency, as in img_xfer)
CONFIG_LORA_BASICS_MODEM_DRIVERS_EVENT_TRIGGER_GLOBAL_THREAD=n
CONFIG_LORA_BASICS_MODEM_DRIVERS_EVENT_TRIGGER_NO_THREAD=y

# ------------------------------ USP -----------------------------

CONFIG_USP=y
CONFIG_USP_MAIN_THREAD=y

# Cooperative threads, USP RAC thread higher priority than main (same as the Semtech samples).
# RAC callbacks run in the USP thread; the LVGL display thread (prio 3, preemptible) only
# runs when both are idle, and is fed through a message queue.
CONFIG_MAIN_THREAD_PRIORITY=-2
CONFIG_USP_MAIN_THREAD_PRIORITY=-4

# ------------------------------ OLED (SSD1306 + LVGL) -------------------------

CONFIG_SSD1306=y
CONFIG_DISPLAY=y
CONFIG_DISPLAY_LOG_LEVEL_ERR=y

CONFIG_LVGL=y
CONFIG_LV_Z_MEM_POOL_SIZE=8192
CONFIG_LV_Z_VDB_SIZE=64
CONFIG_LV_DPI_DEF=148
CONFIG_LV_Z_BITS_PER_PIXEL=1
CONFIG_LV_COLOR_DEPTH_1=y
CONFIG_LV_Z_COLOR_MONO_HW_INVERSION=y

CONFIG_LV_USE_LABEL=y
# Large font for the RX goodput / success lines
CONFIG_LV_FONT_MONTSERRAT_20=y

# It might cause an error if the "CONFIG_LV_USE_THEME_DEFAULT=y" is set when using Zephyr > V4.0
CONFIG_LV_USE_THEME_SIMPLE=y
CONFIG_LV_USE_THEME_MONO=n
```

## boards/oled_addr_0x3d.overlay
```dts
// Board-specific fix, not role-specific: some LoRa Plus expansion boards have the
// SSD1306 strapped to I2C address 0x3D instead of the shield default 0x3C.
// Apply with: -- -DEXTRA_DTC_OVERLAY_FILE=boards/oled_addr_0x3d.overlay
&ssd1306_128x64 {
	reg = <0x3d>;
};
```

## src/main.c
```c
/**
 * @file      main.c
 *
 * @brief     Speed and distance demo: alternates FLRC throughput (SPEED) and LoRa ranging (DISTANCE) phases
 *
 * Copied from flrc_throughput/src/main.c (display thread, stats, OLED check); the phase controller is new.
 * TX board: phase master (timer), FLRC transmitter, ranging subordinate.
 * RX board: FLRC receiver, ranging manager (computes and shows the distance); follows the TX through the switch
 * flag in the FLRC payload, or on its own after CONFIG_APP_RX_FALLBACK_MS without FLRC packets.
 *
 * Structure follows swdm031_img_xfer main.c (display thread + USP main thread) and
 * usp_zephyr samples/usp/sdk/packet_error_rate_flrc main.c (RAC init).
 *
 * The Clear BSD License
 * Copyright Semtech Corporation 2026. All rights reserved.
 *
 * Redistribution and use in source and binary forms, with or without
 * modification, are permitted (subject to the limitations in the disclaimer
 * below) provided that the following conditions are met:
 *     * Redistributions of source code must retain the above copyright
 *       notice, this list of conditions and the following disclaimer.
 *     * Redistributions in binary form must reproduce the above copyright
 *       notice, this list of conditions and the following disclaimer in the
 *       documentation and/or other materials provided with the distribution.
 *     * Neither the name of the Semtech corporation nor the
 *       names of its contributors may be used to endorse or promote products
 *       derived from this software without specific prior written permission.
 *
 * NO EXPRESS OR IMPLIED LICENSES TO ANY PARTY'S PATENT RIGHTS ARE GRANTED BY
 * THIS LICENSE. THIS SOFTWARE IS PROVIDED BY THE COPYRIGHT HOLDERS AND
 * CONTRIBUTORS "AS IS" AND ANY EXPRESS OR IMPLIED WARRANTIES, INCLUDING, BUT
 * NOT LIMITED TO, THE IMPLIED WARRANTIES OF MERCHANTABILITY AND FITNESS FOR A
 * PARTICULAR PURPOSE ARE DISCLAIMED. IN NO EVENT SHALL SEMTECH CORPORATION BE
 * LIABLE FOR ANY DIRECT, INDIRECT, INCIDENTAL, SPECIAL, EXEMPLARY, OR
 * CONSEQUENTIAL DAMAGES (INCLUDING, BUT NOT LIMITED TO, PROCUREMENT OF
 * SUBSTITUTE GOODS OR SERVICES; LOSS OF USE, DATA, OR PROFITS; OR BUSINESS
 * INTERRUPTION) HOWEVER CAUSED AND ON ANY THEORY OF LIABILITY, WHETHER IN
 * CONTRACT, STRICT LIABILITY, OR TORT (INCLUDING NEGLIGENCE OR OTHERWISE)
 * ARISING IN ANY WAY OUT OF THE USE OF THIS SOFTWARE, EVEN IF ADVISED OF THE
 * POSSIBILITY OF SUCH DAMAGE.
 */

#include <stdint.h>
#include <stdbool.h>
#include <stdlib.h>
#include <string.h>

#include <zephyr/kernel.h>
#include <zephyr/device.h>
#include <zephyr/drivers/gpio.h>
#include <zephyr/drivers/i2c.h>
#include <zephyr/logging/log.h>

#include <smtc_zephyr_usp_api.h>
#include <smtc_sw_platform_helper.h>

#include "app_events.h"
#include "app_flrc.h"
#include "app_ranging.h"
#include "oled_display.h"

/*
 * -----------------------------------------------------------------------------
 * --- PRIVATE MACROS-----------------------------------------------------------
 */

LOG_MODULE_REGISTER( main, LOG_LEVEL_INF );

#define STATS_PERIOD_MS ( 1000 )

/* Between phase switches main only formats stats: run it preemptible, below the USP (radio) thread, so console
 * output (polled UART, ~10 ms per line) never delays the radio IRQ handling. */
#define MAIN_RUN_PRIORITY ( 5 )

/* Phase switches touch the radio and the RAC from this thread: run them cooperative (same priority as at boot) so
 * the USP thread cannot preempt half-way through. It still runs whenever this thread sleeps. */
#define MAIN_CTRL_PRIORITY ( -2 )

#define SPEED_MS ( CONFIG_APP_SPEED_PHASE_MS )
#define DISTANCE_MS ( CONFIG_APP_DISTANCE_PHASE_MS )
#define FALLBACK_MS ( CONFIG_APP_RX_FALLBACK_MS )

/* RX: leave SPEED this long before the announced TX switch, and DISTANCE this long before the TX does, so the RX
 * is always listening first. The manager sends its first config this long after the TX switch. */
#define RX_SPEED_EARLY_MS ( 2 )
#define RX_DISTANCE_EARLY_MS ( 30 )
#define RX_FIRST_CFG_DELAY_MS ( 20 )

#define DISPLAY_NODE DT_CHOSEN( zephyr_display )

#define LED0_NODE DT_ALIAS( led0 )

/*
 * -----------------------------------------------------------------------------
 * --- PRIVATE TYPES -----------------------------------------------------------
 */

typedef enum
{
    PHASE_SPEED = 0,
    PHASE_DISTANCE,
} phase_t;

typedef struct
{
    phase_t phase;
    int64_t phase_start_ms;
    int64_t phase_end_ms;  //!< TX: both phases. RX: DISTANCE only.
    uint8_t cycle;         //!< TX: counts SPEED phases. RX: copied from the switch flag packet.
    int64_t stats_last_ms;
    int64_t next_stats_ms;
    uint32_t switches;     //!< Phase switches since boot
} controller_t;

/*
 * -----------------------------------------------------------------------------
 * --- PRIVATE CONSTANTS -------------------------------------------------------
 */

#if DT_NODE_HAS_STATUS( LED0_NODE, okay )
static const struct gpio_dt_spec usr_led = GPIO_DT_SPEC_GET( LED0_NODE, gpios );
#endif

/*
 * -----------------------------------------------------------------------------
 * --- PRIVATE VARIABLES -------------------------------------------------------
 */

K_SEM_DEFINE( app_event_sem, 0, 1 );

static controller_t ctl;

/*
 * -----------------------------------------------------------------------------
 * --- PRIVATE FUNCTIONS DECLARATION -------------------------------------------
 */

static void enter_speed( int64_t now );
static void enter_distance( int64_t now, int64_t end_ms, uint32_t first_cfg_delay_ms, const char* reason );
static void report( int64_t now );
static void report_tx_speed( const app_flrc_stats_t* s, uint32_t elapsed_ms, int64_t now );
static void report_rx_speed( const app_flrc_stats_t* s, uint32_t elapsed_ms );
static void report_distance( int64_t now );
static void show_run( const app_ranging_run_t* run );
static void check_oled( void );
static void format_dm( char* buf, size_t len, int32_t dm );
static void format_cm( char* buf, size_t len, int32_t cm );

/*
 * -----------------------------------------------------------------------------
 * --- PUBLIC FUNCTIONS DEFINITION ---------------------------------------------
 */

void app_event_signal( void )
{
    k_sem_give( &app_event_sem );
}

int main( void )
{
    LOG_INF( "===== Speed and distance demo (%s: FLRC %s, ranging %s) =====", APP_FLRC_IS_TX ? "TX" : "RX",
             APP_FLRC_IS_TX ? "TX" : "RX", APP_RANGING_IS_MANAGER ? "manager" : "subordinate" );
    LOG_INF( "SPEED %u ms, DISTANCE %u ms, switch flag %u ms ahead, RX fallback %u ms", SPEED_MS, DISTANCE_MS,
             CONFIG_APP_SWITCH_WARN_MS, FALLBACK_MS );

    check_oled( );
    display_thread_init( APP_FLRC_IS_TX ? DISPLAY_LAYOUT_TEXT : DISPLAY_LAYOUT_BIG );
    display_text( DISPLAY_ROW1, "Speed & distance %s", APP_FLRC_IS_TX ? "TX" : "RX" );
    display_text( DISPLAY_ROW2, "Starting..." );

#if DT_NODE_HAS_STATUS( LED0_NODE, okay )
    if( gpio_is_ready_dt( &usr_led ) )
    {
        gpio_pin_configure_dt( &usr_led, GPIO_OUTPUT_INACTIVE );
    }
#endif

    SMTC_SW_PLATFORM_INIT( );
    SMTC_SW_PLATFORM_VOID( smtc_rac_init( ) );

    // Open the ranging radio access before the first immediate access
    app_ranging_init( );
    app_flrc_init( );

    ctl.phase = PHASE_DISTANCE;  // So enter_speed() does not try to stop a ranging that never ran
    enter_speed( k_uptime_get( ) );

    while( true )
    {
        int64_t deadline = ctl.next_stats_ms;
        int64_t now      = k_uptime_get( );

        if( APP_RANGING_IS_MANAGER && ( ctl.phase == PHASE_DISTANCE ) )
        {
            app_ranging_run_t run;
            if( app_ranging_get_run( &run ) )
            {
                show_run( &run );
            }
        }

        // RX in SPEED: switch notice from the TX, or fallback after FALLBACK_MS without packets
        uint32_t notice_at_32 = 0;
        uint8_t  notice_cycle = 0;
        bool     notice       = false;
        int64_t  notice_at    = 0;
        int64_t  fallback_at  = 0;

        if( ( ctl.phase == PHASE_SPEED ) && !APP_FLRC_IS_TX )
        {
            notice = app_flrc_get_switch_notice( &notice_at_32, &notice_cycle );
            if( notice )
            {
                notice_at = now + ( int32_t ) ( notice_at_32 - ( uint32_t ) now );
                deadline  = MIN( deadline, notice_at - RX_SPEED_EARLY_MS );
            }
            else
            {
                fallback_at = now + ( int32_t ) ( app_flrc_get_last_rx_ms( ) - ( uint32_t ) now ) + FALLBACK_MS;
                deadline    = MIN( deadline, fallback_at );
            }
        }
        else
        {
            deadline = MIN( deadline, ctl.phase_end_ms );
        }

        if( deadline > now )
        {
            // Absolute wake-up (no drift); radio callbacks wake it early through app_event_signal()
            ( void ) k_sem_take( &app_event_sem, K_TIMEOUT_ABS_MS( deadline ) );
            continue;  // Re-evaluate with fresh state
        }

        // --- deadline reached ---
        if( now >= ctl.next_stats_ms )
        {
            report( now );
        }

        if( APP_FLRC_IS_TX )
        {
            if( now >= ctl.phase_end_ms )
            {
                if( ctl.phase == PHASE_SPEED )
                {
                    enter_distance( now, now + DISTANCE_MS, 0, "timer" );
                }
                else
                {
                    enter_speed( now );
                }
            }
        }
        else if( ctl.phase == PHASE_SPEED )
        {
            if( notice && ( now >= notice_at - RX_SPEED_EARLY_MS ) )
            {
                ctl.cycle = notice_cycle;
                const int32_t to_switch = MAX( 0, ( int32_t ) ( notice_at - now ) );
                enter_distance( now, notice_at + DISTANCE_MS - RX_DISTANCE_EARLY_MS,
                                ( uint32_t ) to_switch + RX_FIRST_CFG_DELAY_MS, "flag" );
            }
            else if( !notice && ( now >= fallback_at ) )
            {
                // TX silent for FALLBACK_MS: it is in DISTANCE (or off). It has at most DISTANCE_MS - FALLBACK_MS
                // left there, so do not stay longer than that.
                enter_distance( now, now + DISTANCE_MS - FALLBACK_MS, 0, "no FLRC" );
            }
        }
        else if( now >= ctl.phase_end_ms )
        {
            enter_speed( now );
        }
    }

    return 0;
}

/*
 * -----------------------------------------------------------------------------
 * --- PRIVATE FUNCTIONS DEFINITION --------------------------------------------
 */

static void enter_speed( int64_t now )
{
    if( APP_FLRC_IS_TX )
    {
        ctl.cycle += 1;
    }

    k_thread_priority_set( k_current_get( ), MAIN_CTRL_PRIORITY );
    if( ctl.phase == PHASE_DISTANCE )
    {
        app_ranging_stop( );
    }
    now = k_uptime_get( );
    ctl.phase_start_ms = now;
    ctl.phase_end_ms   = APP_FLRC_IS_TX ? now + SPEED_MS : INT64_MAX;
    app_flrc_start( ( uint32_t ) ctl.phase_end_ms, ctl.cycle );
    ctl.phase = PHASE_SPEED;
    k_thread_priority_set( k_current_get( ), MAIN_RUN_PRIORITY );

    // Fresh 1 s stats windows aligned on the phase start
    app_flrc_stats_t discard;
    app_flrc_get_and_reset_stats( &discard );
    ctl.stats_last_ms = now;
    ctl.next_stats_ms = now + STATS_PERIOD_MS;
    ctl.switches += 1;

    printk( "=== SPEED (FLRC %s) cycle %u, t=%u ms, switch #%u\n", APP_FLRC_IS_TX ? "TX" : "RX", ctl.cycle, ( uint32_t ) now,
            ctl.switches );

    if( APP_FLRC_IS_TX )
    {
        display_text( DISPLAY_ROW1, "SPEED  FLRC TX  #%u", ctl.cycle );
        display_text( DISPLAY_ROW2, "%u MHz %+d dBm %uB", CONFIG_APP_RF_FREQ_MHZ, CONFIG_APP_TX_POWER_DBM,
                      APP_FLRC_PAYLOAD_SIZE );
        display_text( DISPLAY_ROW3, "Pkts/s: -" );
        display_text( DISPLAY_ROW4, "TX: -.-- Mbps" );
        display_text( DISPLAY_ROW5, " " );
        display_text( DISPLAY_ROW6, "-> DIST in %u s", SPEED_MS / 1000 );
    }
    else
    {
        display_text( DISPLAY_ROW1, "SPEED  FLRC RX %u", CONFIG_APP_RF_FREQ_MHZ );
        display_text( DISPLAY_ROW2, "-.-- Mbps" );
        display_text( DISPLAY_ROW3, "waiting" );
        display_text( DISPLAY_ROW4, "2.6 Mbps raw CR1/1 %uB", APP_FLRC_PAYLOAD_SIZE );
    }
}

static void enter_distance( int64_t now, int64_t end_ms, uint32_t first_cfg_delay_ms, const char* reason )
{
    // Last (partial) SPEED stats window
    if( now - ctl.stats_last_ms >= 50 )
    {
        report( now );
    }

    k_thread_priority_set( k_current_get( ), MAIN_CTRL_PRIORITY );
    app_flrc_stop( );
    now = k_uptime_get( );
    ctl.phase_start_ms = now;
    ctl.phase_end_ms   = end_ms;
    app_ranging_start( ( uint32_t ) MAX( 0, end_ms - now ), first_cfg_delay_ms );
    ctl.phase = PHASE_DISTANCE;
    k_thread_priority_set( k_current_get( ), MAIN_RUN_PRIORITY );

    ctl.stats_last_ms = now;
    ctl.next_stats_ms = now + STATS_PERIOD_MS;
    ctl.switches += 1;

    printk( "=== DISTANCE (ranging %s) cycle %u, t=%u ms, %d ms window, reason: %s, switch #%u\n",
            APP_RANGING_IS_MANAGER ? "manager" : "subordinate", ctl.cycle, ( uint32_t ) now, ( int ) ( end_ms - now ), reason, ctl.switches );

    if( APP_FLRC_IS_TX )
    {
        display_text( DISPLAY_ROW1, "DIST  ranging SUB  #%u", ctl.cycle );
        display_text( DISPLAY_ROW2, "LoRa SF%d BW812 2G4 hop", CONFIG_APP_RANGING_SF );
        display_text( DISPLAY_ROW3, "waiting for manager" );
        display_text( DISPLAY_ROW4, " " );
        display_text( DISPLAY_ROW5, " " );
        display_text( DISPLAY_ROW6, "-> SPEED in %u s", DISTANCE_MS / 1000 );
    }
    else
    {
        display_text( DISPLAY_ROW1, "DIST  ranging MGR  #%u", ctl.cycle );
        display_text( DISPLAY_ROW2, "-.- m" );
        display_text( DISPLAY_ROW3, "ranging..." );
        display_text( DISPLAY_ROW4, "SF%d BW812 2G4 hop (%s)", CONFIG_APP_RANGING_SF, reason );
    }
}

static void report( int64_t now )
{
    const uint32_t elapsed_ms = ( uint32_t ) ( now - ctl.stats_last_ms );

    ctl.stats_last_ms = now;
    ctl.next_stats_ms = now + STATS_PERIOD_MS;

    if( ctl.phase == PHASE_SPEED )
    {
        app_flrc_stats_t stats;
        app_flrc_get_and_reset_stats( &stats );
        if( APP_FLRC_IS_TX )
        {
            report_tx_speed( &stats, elapsed_ms, now );
        }
        else
        {
            report_rx_speed( &stats, elapsed_ms );
        }
    }
    else
    {
        report_distance( now );
    }

#if DT_NODE_HAS_STATUS( LED0_NODE, okay )
    gpio_pin_toggle_dt( &usr_led );
#endif
}

/*!
 * @brief Integer kbps from bytes over a period (bits per ms == kbit/s)
 */
static uint32_t to_kbps( uint32_t bytes, uint32_t elapsed_ms )
{
    return ( elapsed_ms == 0 ) ? 0 : ( uint32_t ) ( ( ( uint64_t ) bytes * 8U ) / elapsed_ms );
}

static void report_tx_speed( const app_flrc_stats_t* s, uint32_t elapsed_ms, int64_t now )
{
    const uint32_t kbps    = to_kbps( s->tx_done * APP_FLRC_PAYLOAD_SIZE, elapsed_ms );
    const uint32_t pkt_s   = ( elapsed_ms == 0 ) ? 0 : ( s->tx_done * 1000U ) / elapsed_ms;
    const uint32_t mbps    = kbps / 1000U;
    const uint32_t mbps_cd = ( kbps % 1000U ) / 10U;
    const int64_t  left_ms = MAX( 0, ctl.phase_end_ms - now );

    display_text( DISPLAY_ROW3, "Pkts/s: %u", pkt_s );
    display_text( DISPLAY_ROW4, "TX: %u.%02u Mbps", mbps, mbps_cd );
    display_text( DISPLAY_ROW5, "Seq: %u  err: %u", s->last_seq, s->tx_errors );
    display_text( DISPLAY_ROW6, "-> DIST in %u s", ( uint32_t ) ( ( left_ms + 999 ) / 1000 ) );

    printk( "TX SPEED %u ms: %u pkt (%u pkt/s), %u.%02u Mbps payload, seq %u, err %u, disp %u\n", elapsed_ms,
            s->tx_done, pkt_s, mbps, mbps_cd, s->last_seq, s->tx_errors, display_get_refresh_count( ) );
}

static void report_rx_speed( const app_flrc_stats_t* s, uint32_t elapsed_ms )
{
    const uint32_t kbps    = to_kbps( s->rx_bytes, elapsed_ms );
    const uint32_t mbps    = kbps / 1000U;
    const uint32_t mbps_cd = ( kbps % 1000U ) / 10U;
    uint32_t       ok_x10  = 0;

    display_text( DISPLAY_ROW2, "%u.%02u Mbps", mbps, mbps_cd );

    // Success in 0.1 %: good packets over the sequence span the TX covered in this window
    if( s->rx_expected > 0 )
    {
        ok_x10 = ( uint32_t ) ( ( ( uint64_t ) s->rx_ok * 1000U ) / s->rx_expected );
        display_text( DISPLAY_ROW3, "%u.%u%% pkts", ok_x10 / 10U, ok_x10 % 10U );
    }
    else
    {
        display_text( DISPLAY_ROW3, "no packets" );
    }

    if( s->rssi_valid )
    {
        display_text( DISPLAY_ROW4, "RSSI %d  CRC %u  lost %u", s->last_rssi, s->crc_errors,
                      s->rx_expected - s->rx_ok );
    }

    printk( "RX SPEED %u ms: ok %u / exp %u (%u.%u%%), %u.%02u Mbps goodput, crc %u, tmo %u, resync %u, fifo %u, "
            "seq %u, rssi %d, disp %u\n",
            elapsed_ms, s->rx_ok, s->rx_expected, ok_x10 / 10U, ok_x10 % 10U, mbps, mbps_cd, s->crc_errors,
            s->rx_timeouts, s->resyncs, s->fifo_resets, s->last_seq, s->last_rssi, display_get_refresh_count( ) );
}

static void report_distance( int64_t now )
{
    app_ranging_stats_t st;
    app_ranging_get_stats( &st );
    const int64_t left_ms = MAX( 0, ctl.phase_end_ms - now );

    if( APP_RANGING_IS_MANAGER )
    {
        printk( "RX DIST: cfg %u, ack %u, runs %u, exch ok %u fail %u, %d ms left\n", st.cfg_tx, st.cfg_ok, st.runs,
                st.exch_ok, st.exch_fail, ( int ) left_ms );
    }
    else
    {
        display_text( DISPLAY_ROW3, "cfg ok: %u  runs: %u", st.cfg_ok, st.runs );
        display_text( DISPLAY_ROW4, "answered: %u", st.exch_ok );
        display_text( DISPLAY_ROW5, "missed: %u  cut: %u", st.exch_fail, st.runs_cut );
        display_text( DISPLAY_ROW6, "-> SPEED in %u s", ( uint32_t ) ( ( left_ms + 999 ) / 1000 ) );
        printk( "TX DIST: cfg rx windows %u, cfg ok %u, runs %u (cut %u), answered %u, missed %u, %d ms left\n",
                st.cfg_tx, st.cfg_ok, st.runs, st.runs_cut, st.exch_ok, st.exch_fail, ( int ) left_ms );
    }
}

/* Manager: smoothed distance = median of the last CONFIG_APP_RANGING_SMOOTH_RUNS run results (kept across phases,
 * cleared after SMOOTH_RESET_MS without a result); spread = median absolute deviation of the same values. */
#define SMOOTH_N ( CONFIG_APP_RANGING_SMOOTH_RUNS )
#define SMOOTH_RESET_MS ( 30000 )

static int32_t smooth_cm[SMOOTH_N];
static uint8_t smooth_count;
static uint8_t smooth_next;
static int64_t smooth_last_ms;

static int32_t median_of( int32_t* v, uint8_t n )
{
    for( uint8_t i = 1; i < n; i++ )
    {
        const int32_t x = v[i];
        int8_t        j = ( int8_t ) i - 1;
        while( ( j >= 0 ) && ( v[j] > x ) )
        {
            v[j + 1] = v[j];
            j--;
        }
        v[j + 1] = x;
    }
    return ( ( n % 2 ) == 1 ) ? v[n / 2] : ( v[n / 2 - 1] + v[n / 2] ) / 2;
}

static void smooth_add( int32_t cm, int32_t* med_cm, int32_t* mad_cm, uint8_t* n )
{
    const int64_t now = k_uptime_get( );

    if( ( smooth_count > 0 ) && ( now - smooth_last_ms > SMOOTH_RESET_MS ) )
    {
        smooth_count = 0;
        smooth_next  = 0;
    }
    smooth_last_ms          = now;
    smooth_cm[smooth_next]  = cm;
    smooth_next             = ( smooth_next + 1 ) % SMOOTH_N;
    smooth_count            = MIN( smooth_count + 1, SMOOTH_N );

    int32_t tmp[SMOOTH_N];
    memcpy( tmp, smooth_cm, smooth_count * sizeof( int32_t ) );
    *med_cm = median_of( tmp, smooth_count );
    for( uint8_t i = 0; i < smooth_count; i++ )
    {
        tmp[i] = abs( smooth_cm[i] - *med_cm );
    }
    *mad_cm = median_of( tmp, smooth_count );
    *n      = smooth_count;
}

static void format_dm( char* buf, size_t len, int32_t dm )
{
    const uint32_t mag = ( uint32_t ) abs( dm );
    snprintf( buf, len, "%s%u.%u", ( dm < 0 ) ? "-" : "", mag / 10U, mag % 10U );
}

/* cm -> "x.y" with sign, rounded to dm */
static void format_cm( char* buf, size_t len, int32_t cm )
{
    const int32_t dm = ( cm >= 0 ) ? ( cm + 5 ) / 10 : ( cm - 5 ) / 10;
    format_dm( buf, len, dm );
}

/* Manager: one completed run -> console (per-hop detail) + OLED (smoothed) */
static void show_run( const app_ranging_run_t* run )
{
    char run_m[24];
    char avg_m[24];
    char mad_m[24];

    // Per hop: raw result, "x" = no valid exchange, "*" suffix = dropped by the RSSI filter
    printk( "HOPS run %u raw/rssi:", run->run_id );
    for( uint8_t i = 0; i < run->total; i++ )
    {
        if( !run->hop_valid[i] )
        {
            printk( " x" );
        }
        else
        {
            printk( " %d/%d%s", run->hop_raw[i], run->hop_rssi[i], run->hop_used[i] ? "" : "*" );
        }
    }
    printk( "\n" );

    if( run->used == 0 )
    {
        printk( "RANGE run %u: no valid exchange (%u valid / %u)\n", run->run_id, run->valid, run->total );
        display_text( DISPLAY_ROW4, "run %u: 0/%u valid", run->run_id, run->total );
        return;
    }

    int32_t med_cm;
    int32_t mad_cm;
    uint8_t n;
    smooth_add( run->distance_cm, &med_cm, &mad_cm, &n );

    format_cm( run_m, sizeof( run_m ), run->distance_cm );
    format_cm( avg_m, sizeof( avg_m ), med_cm );
    format_cm( mad_m, sizeof( mad_m ), mad_cm );

    printk( "RANGE run %u: %s m (raw median %d, %d cm uncal), used %u / valid %u / %u, rssi %d | shown %s m +/-%s "
            "(median of %u)\n",
            run->run_id, run_m, run->median_raw, app_ranging_raw_to_cm( run->median_raw ), run->used, run->valid,
            run->total, run->rssi, avg_m, mad_m, n );

    display_text( DISPLAY_ROW2, "%s m", avg_m );
    display_text( DISPLAY_ROW3, "+/-%s  n=%u", mad_m, n );
    display_text( DISPLAY_ROW4, "run %s m %u/%u RSSI %d", run_m, run->used, run->total, run->rssi );
}

/*!
 * @brief Log whether the OLED answers on I2C (diagnostic for a dark screen)
 */
static void check_oled( void )
{
    const struct device* display_dev = DEVICE_DT_GET( DISPLAY_NODE );
    const struct device* i2c_dev     = DEVICE_DT_GET( DT_BUS( DISPLAY_NODE ) );

    if( device_is_ready( display_dev ) )
    {
        LOG_INF( "OLED ready" );
        return;
    }

    LOG_ERR( "OLED driver not ready: probing I2C bus %s", i2c_dev->name );
    if( !device_is_ready( i2c_dev ) )
    {
        LOG_ERR( "I2C bus not ready" );
        return;
    }

    // SSD1306 control byte 0x00 (command stream) with no command: harmless if a device answers
    const uint8_t ctrl = 0x00;
    for( uint16_t addr = 0x3C; addr <= 0x3D; addr++ )
    {
        const int ret = i2c_write( i2c_dev, &ctrl, 1, addr );
        LOG_ERR( "  0x%02X: %s (%d)", addr, ( ret == 0 ) ? "ACK" : "NACK", ret );
    }
}

/* --- EOF ------------------------------------------------------------------ */
```

## src/app_events.h
```c
/*
 * SPDX-License-Identifier: MIT
 *
 * Wake-up path from the radio callbacks (USP thread) to the main phase controller.
 */

#ifndef APP_EVENTS_H
#define APP_EVENTS_H

/*!
 * @brief Wake the main thread (k_sem_give). Safe from the USP thread; never blocks.
 */
void app_event_signal( void );

#endif  // APP_EVENTS_H
```

## src/app_flrc.c
```c
/**
 * @file      app_flrc.c
 *
 * @brief     One-way FLRC throughput (SPEED phase): TX streams, RX measures goodput / success rate
 *
 * Copied from flrc_throughput/src/app_flrc.c, with start/stop added so the radio can be handed back to the
 * RAC scheduler for ranging between SPEED phases, and a mode-switch flag in the payload header.
 *
 * Derived from usp examples/main_examples/packet_error_rate_flrc_example (app_per_flrc.c):
 * same FLRC parameters, but the RAC scheduler is bypassed for the data path: the app takes the
 * radio with smtc_rac_immediate_radio_access() (as in the immediate_radio_access example) and
 * drives the LR20xx directly. The radio is configured once; then
 *   - TX: SetTx on each TX_DONE, with the next payload already pre-loaded in the 1024-byte TX FIFO;
 *   - RX: continuous RX (radio stays in RX), FIFO drained on each RX_DONE.
 * The per-packet RAC path (setup + ms scheduler) cost ~3 ms/packet and capped goodput at ~0.8 Mbps.
 *
 * The Clear BSD License
 * Copyright Semtech Corporation 2024. All rights reserved.
 *
 * Redistribution and use in source and binary forms, with or without
 * modification, are permitted (subject to the limitations in the disclaimer
 * below) provided that the following conditions are met:
 *     * Redistributions of source code must retain the above copyright
 *       notice, this list of conditions and the following disclaimer.
 *     * Redistributions in binary form must reproduce the above copyright
 *       notice, this list of conditions and the following disclaimer in the
 *       documentation and/or other materials provided with the distribution.
 *     * Neither the name of the Semtech corporation nor the
 *       names of its contributors may be used to endorse or promote products
 *       derived from this software without specific prior written permission.
 *
 * NO EXPRESS OR IMPLIED LICENSES TO ANY PARTY'S PATENT RIGHTS ARE GRANTED BY
 * THIS LICENSE. THIS SOFTWARE IS PROVIDED BY THE COPYRIGHT HOLDERS AND
 * CONTRIBUTORS "AS IS" AND ANY EXPRESS OR IMPLIED WARRANTIES, INCLUDING, BUT
 * NOT LIMITED TO, THE IMPLIED WARRANTIES OF MERCHANTABILITY AND FITNESS FOR A
 * PARTICULAR PURPOSE ARE DISCLAIMED. IN NO EVENT SHALL SEMTECH CORPORATION BE
 * LIABLE FOR ANY DIRECT, INDIRECT, INCIDENTAL, SPECIAL, EXEMPLARY, OR
 * CONSEQUENTIAL DAMAGES (INCLUDING, BUT NOT LIMITED TO, PROCUREMENT OF
 * SUBSTITUTE GOODS OR SERVICES; LOSS OF USE, DATA, OR PROFITS; OR BUSINESS
 * INTERRUPTION) HOWEVER CAUSED AND ON ANY THEORY OF LIABILITY, WHETHER IN
 * CONTRACT, STRICT LIABILITY, OR TORT (INCLUDING NEGLIGENCE OR OTHERWISE)
 * ARISING IN ANY WAY OUT OF THE USE OF THIS SOFTWARE, EVEN IF ADVISED OF THE
 * POSSIBILITY OF SUCH DAMAGE.
 */

#include <stddef.h>
#include <stdint.h>
#include <string.h>

#include <zephyr/kernel.h>

#include "app_flrc.h"
#include "app_events.h"
#include "app_radio_limits.h"

#include "smtc_rac_api.h"
#include "smtc_modem_hal.h"

#include "ral_lr20xx.h"
#include "lr20xx_system.h"
#include "lr20xx_radio_common.h"
#include "lr20xx_radio_fifo.h"

/*
 * -----------------------------------------------------------------------------
 * --- PRIVATE CONSTANTS -------------------------------------------------------
 */

/* FLRC radio parameters. Enum names from usp smtc_rac_lib/smtc_ral/src/ral_defs.h */
#define FLRC_RAW_BIT_RATE RAL_FLRC_RAW_BIT_RATE_2_600_MBPS  // Highest FLRC rate (LR20XX_RADIO_FLRC_BR_2_600_BW_2_666)
#define FLRC_CR RAL_FLRC_CR_1_1                              // No FEC (LR20XX_RADIO_FLRC_CR_NONE)
#define FLRC_PULSE_SHAPE RAL_FLRC_PULSE_SHAPE_BT_05
#define FLRC_PREAMBLE_BITS RAL_FLRC_PREAMBLE_LENGTH_32_BITS
#define FLRC_SYNCWORD_LEN RAL_FLRC_SYNCWORD_LENGTH_4_BYTES
#define FLRC_TX_SYNCWORD RAL_FLRC_TX_SYNCWORD_1
#define FLRC_MATCH_SYNCWORD RAL_FLRC_RX_MATCH_SYNCWORD_1
#define FLRC_PLD_IS_FIX false  // Variable length (header carries the length)
#define FLRC_CRC RAL_FLRC_CRC_2_BYTES

#define SEQ_SIZE ( 4 )
#define SEQ_OFFSET ( 0 )
#define FLAGS_OFFSET ( 4 )
#define SWITCH_MS_OFFSET ( 5 )
#define CYCLE_OFFSET ( 7 )

APP_ASSERT_FREQ_IN_ISM_2G4( APP_FLRC_RF_FREQ_IN_HZ );
BUILD_ASSERT( APP_FLRC_PAYLOAD_SIZE >= APP_FLRC_HDR_SIZE, "payload too small for the header" );

/* LR20xx FIFOs are switched to 1024 bytes by ral_lr20xx_init() (LR20XX_FIFO_SIZE_INCREASE_WORKAROUND_ENABLE) */
#define RADIO_FIFO_SIZE ( 1024 )

/* RAL and LR20xx driver statuses both use 0 for OK */
#define PANIC_IF_ERR( x ) SMTC_MODEM_HAL_PANIC_ON_FAILURE( ( int ) ( x ) == 0 )

/*
 * -----------------------------------------------------------------------------
 * --- PRIVATE TYPES -----------------------------------------------------------
 */

typedef struct flrc_throughput_s
{
    uint8_t          tx_payload[APP_FLRC_PAYLOAD_SIZE];
    uint8_t          rx_payload[RADIO_FIFO_SIZE];
    void*            radio;       //!< LR20xx driver context
    bool             tx_pipeline; //!< Next TX payload is pre-loaded in the FIFO
    uint32_t         tx_seq;      //!< Sequence number of the packet on air
    uint32_t         rx_seq;      //!< Last sequence number received
    bool             rx_synced;   //!< rx_seq is valid
    volatile bool    running;     //!< FLRC owns the radio (immediate access held)
    uint32_t         switch_at_ms;  //!< TX: end of this SPEED phase (k_uptime_get_32)
    uint8_t          cycle;         //!< TX: cycle counter for the header
    volatile bool     notice_valid;   //!< RX: switch flag seen in this phase
    volatile uint32_t notice_at_ms;   //!< RX: TX switch time derived from the flag packet
    volatile uint8_t  notice_cycle;   //!< RX: cycle counter of the flag packet
    volatile uint32_t last_rx_ms;     //!< RX: time of the last good packet
    app_flrc_stats_t stats;
} flrc_throughput_t;

/*
 * -----------------------------------------------------------------------------
 * --- PRIVATE VARIABLES -------------------------------------------------------
 */

static flrc_throughput_t flrc = { 0 };

static const uint8_t default_syncword_1[4] = { 0x90, 0x56, 0x34, 0x12 };
static const uint8_t default_syncword_2[4] = { 0x00, 0x00, 0x00, 0x00 };
static const uint8_t default_syncword_3[4] = { 0x00, 0x00, 0x00, 0x00 };

/*
 * -----------------------------------------------------------------------------
 * --- PRIVATE FUNCTIONS DECLARATION -------------------------------------------
 */

static void radio_configure( void );
static void irq_callback( void );
static void tx_load_payload( uint32_t seq );
static void rx_drain_packet( bool crc_ok );
static void rx_account_packet( uint32_t seq, uint16_t size, int16_t rssi );
static void rx_check_switch_flag( void );

/*
 * -----------------------------------------------------------------------------
 * --- PUBLIC FUNCTIONS DEFINITION ---------------------------------------------
 */

void app_flrc_init( void )
{
    // Filler: incremental byte pattern after the header (as app_per_flrc.c)
    for( uint16_t i = APP_FLRC_HDR_SIZE; i < APP_FLRC_PAYLOAD_SIZE; i++ )
    {
        flrc.tx_payload[i] = ( uint8_t ) i;
    }

    // Pre-loading needs room for two packets in the TX FIFO
    flrc.tx_pipeline = IS_ENABLED( CONFIG_APP_TX_PIPELINE ) && ( 2 * APP_FLRC_PAYLOAD_SIZE <= RADIO_FIFO_SIZE );

    printk( "FLRC %s: %u Hz, %d dBm, %s, %s, %u B payload, CRC 2 B, direct radio access%s\n",
            APP_FLRC_IS_TX ? "TX" : "RX", ( unsigned int ) APP_FLRC_RF_FREQ_IN_HZ, APP_FLRC_TX_POWER_DBM,
            ral_flrc_raw_bit_rate_to_str( FLRC_RAW_BIT_RATE ), ral_flrc_cr_to_str( FLRC_CR ), APP_FLRC_PAYLOAD_SIZE,
            ( APP_FLRC_IS_TX && flrc.tx_pipeline ) ? ", TX FIFO pre-load" : "" );
}

void app_flrc_start( uint32_t switch_at_ms, uint8_t cycle )
{
    flrc.switch_at_ms = switch_at_ms;
    flrc.cycle        = cycle;
    flrc.notice_valid = false;
    flrc.rx_synced    = false;  // Packets missed during the DISTANCE phase are not losses
    flrc.last_rx_ms   = k_uptime_get_32( );

    // Take the radio away from the RAC scheduler. irq_callback() then runs in the USP thread on each radio IRQ.
    // If a RAC task is still running, the planner aborts it and puts the radio in standby first.
    SMTC_MODEM_HAL_PANIC_ON_FAILURE( smtc_rac_immediate_radio_access( RAC_VERY_HIGH_PRIORITY, irq_callback ) ==
                                     SMTC_RAC_SUCCESS );
    flrc.radio = smtc_rac_get_radio_driver_context( );

    radio_configure( );
    flrc.running = true;

    if( APP_FLRC_IS_TX )
    {
        PANIC_IF_ERR( lr20xx_radio_fifo_clear_tx( flrc.radio ) );
        tx_load_payload( flrc.tx_seq );
        PANIC_IF_ERR( lr20xx_radio_common_set_tx( flrc.radio, 0 ) );
        if( flrc.tx_pipeline )
        {
            // Queue packet #1 behind packet #0 while #0 is on air
            tx_load_payload( flrc.tx_seq + 1 );
        }
    }
    else
    {
        // Continuous RX: the radio stays in RX after each packet (ral_lr20xx_set_rx() clears the RX FIFO)
        PANIC_IF_ERR( ral_lr20xx_set_rx( flrc.radio, RAL_RX_TIMEOUT_CONTINUOUS_MODE ) );
    }
}

void app_flrc_stop( void )
{
    // irq_callback() checks this first: no new SetTx / FIFO access from now on
    flrc.running = false;

    PANIC_IF_ERR( ral_lr20xx_set_standby( flrc.radio, RAL_STANDBY_CFG_XOSC ) );
    PANIC_IF_ERR( ral_lr20xx_clear_irq_status( flrc.radio, RAL_IRQ_ALL ) );
    PANIC_IF_ERR( lr20xx_radio_fifo_clear_tx( flrc.radio ) );
    PANIC_IF_ERR( lr20xx_radio_fifo_clear_rx( flrc.radio ) );
    // RAC never sets the fallback mode: put back the chip default we changed for FLRC TX
    PANIC_IF_ERR( ral_lr20xx_set_rx_tx_fallback_mode( flrc.radio, RAL_FALLBACK_STDBY_RC ) );

    SMTC_MODEM_HAL_PANIC_ON_FAILURE( smtc_rac_release_immediate_radio_access( ) == SMTC_RAC_SUCCESS );
}

bool app_flrc_get_switch_notice( uint32_t* switch_at_ms, uint8_t* cycle )
{
    unsigned int key = irq_lock( );
    const bool   ok  = flrc.notice_valid;
    *switch_at_ms    = flrc.notice_at_ms;
    *cycle           = flrc.notice_cycle;
    irq_unlock( key );
    return ok;
}

uint32_t app_flrc_get_last_rx_ms( void )
{
    return flrc.last_rx_ms;
}

void app_flrc_get_and_reset_stats( app_flrc_stats_t* stats )
{
    // Counters are written by the radio IRQ callback: copy + reset under lock
    unsigned int key = irq_lock( );

    *stats = flrc.stats;

    flrc.stats.tx_done     = 0;
    flrc.stats.tx_errors   = 0;
    flrc.stats.rx_ok       = 0;
    flrc.stats.rx_bytes    = 0;
    flrc.stats.rx_expected = 0;
    flrc.stats.crc_errors  = 0;
    flrc.stats.rx_timeouts = 0;
    flrc.stats.resyncs     = 0;
    flrc.stats.fifo_resets = 0;

    irq_unlock( key );
}

/*
 * -----------------------------------------------------------------------------
 * --- PRIVATE FUNCTIONS DEFINITION --------------------------------------------
 */

/* FLRC setup at the start of each SPEED phase: same sequence as ralf_lr20xx_setup_flrc(), called on the driver context */
static void radio_configure( void )
{
    const ral_flrc_mod_params_t mod_params = {
        .raw_bit_rate = FLRC_RAW_BIT_RATE,
        .cr           = FLRC_CR,
        .pulse_shape  = FLRC_PULSE_SHAPE,
    };
    const ral_flrc_pkt_params_t pkt_params = {
        .preamble_len     = FLRC_PREAMBLE_BITS,
        .sync_word_len    = FLRC_SYNCWORD_LEN,
        .tx_syncword      = FLRC_TX_SYNCWORD,
        .match_sync_word  = FLRC_MATCH_SYNCWORD,
        .pld_is_fix       = FLRC_PLD_IS_FIX,
        .pld_len_in_bytes = APP_FLRC_PAYLOAD_SIZE,  // TX length / RX max length
        .crc_type         = FLRC_CRC,
    };

    PANIC_IF_ERR( ral_lr20xx_set_standby( flrc.radio, RAL_STANDBY_CFG_XOSC ) );
    PANIC_IF_ERR( ral_lr20xx_set_pkt_type( flrc.radio, RAL_PKT_TYPE_FLRC ) );
    // >= 1.5 GHz: the LR20xx BSP selects the HF RX path (and below, the HF PA). Never the sub-GHz path here.
    app_radio_check_freq( APP_FLRC_RF_FREQ_IN_HZ );
    PANIC_IF_ERR( ral_lr20xx_set_rf_freq( flrc.radio, APP_FLRC_RF_FREQ_IN_HZ ) );
    PANIC_IF_ERR( ral_lr20xx_set_flrc_mod_params( flrc.radio, &mod_params ) );
    PANIC_IF_ERR( ral_lr20xx_set_flrc_pkt_params( flrc.radio, &pkt_params ) );
    PANIC_IF_ERR( ral_lr20xx_set_flrc_crc_params( flrc.radio, 0, 0 ) );  // Keep chip default CRC seed/polynomial

    if( APP_FLRC_IS_TX )
    {
        PANIC_IF_ERR( ral_lr20xx_set_tx_cfg( flrc.radio, APP_FLRC_TX_POWER_DBM, APP_FLRC_RF_FREQ_IN_HZ ) );
        PANIC_IF_ERR( ral_lr20xx_set_flrc_sync_word( flrc.radio, FLRC_TX_SYNCWORD, default_syncword_1,
                                                     FLRC_SYNCWORD_LEN ) );
        // Stay in FS between packets: shortest turnaround to the next SetTx
        PANIC_IF_ERR( ral_lr20xx_set_rx_tx_fallback_mode( flrc.radio, RAL_FALLBACK_FS ) );
        PANIC_IF_ERR( ral_lr20xx_set_dio_irq_params( flrc.radio, RAL_IRQ_TX_DONE ) );
    }
    else
    {
        PANIC_IF_ERR( ral_lr20xx_set_flrc_sync_word( flrc.radio, 1, default_syncword_1, FLRC_SYNCWORD_LEN ) );
        PANIC_IF_ERR( ral_lr20xx_set_flrc_sync_word( flrc.radio, 2, default_syncword_2, FLRC_SYNCWORD_LEN ) );
        PANIC_IF_ERR( ral_lr20xx_set_flrc_sync_word( flrc.radio, 3, default_syncword_3, FLRC_SYNCWORD_LEN ) );
        PANIC_IF_ERR( ral_lr20xx_set_dio_irq_params(
            flrc.radio, RAL_IRQ_RX_DONE | RAL_IRQ_RX_CRC_ERROR | RAL_IRQ_RX_LEN_ERROR | RAL_IRQ_RX_TIMEOUT ) );
    }

    PANIC_IF_ERR( ral_lr20xx_clear_irq_status( flrc.radio, RAL_IRQ_ALL ) );
}

/* Runs in the USP thread on each radio IRQ: keep it short, never touch LVGL / I2C here */
static void irq_callback( void )
{
    lr20xx_system_irq_mask_t irq = LR20XX_SYSTEM_IRQ_NONE;

    if( !flrc.running )
    {
        return;
    }

    lr20xx_system_get_and_clear_irq_status( flrc.radio, &irq );

    if( APP_FLRC_IS_TX )
    {
        if( ( irq & LR20XX_SYSTEM_IRQ_TX_DONE ) != 0 )
        {
            flrc.stats.tx_done += 1;
            flrc.stats.last_seq = flrc.tx_seq;
            flrc.tx_seq += 1;

            if( flrc.tx_pipeline )
            {
                // Next payload is already in the FIFO: start it first, then queue the one after it
                lr20xx_radio_common_set_tx( flrc.radio, 0 );
                tx_load_payload( flrc.tx_seq + 1 );
            }
            else
            {
                tx_load_payload( flrc.tx_seq );
                lr20xx_radio_common_set_tx( flrc.radio, 0 );
            }
        }
        else if( irq != LR20XX_SYSTEM_IRQ_NONE )
        {
            flrc.stats.tx_errors += 1;
        }
        return;
    }

    // RX: the radio is still in continuous RX, only the FIFO needs draining
    if( ( irq & ( LR20XX_SYSTEM_IRQ_CRC_ERROR | LR20XX_SYSTEM_IRQ_LEN_ERROR ) ) != 0 )
    {
        flrc.stats.crc_errors += 1;
        rx_drain_packet( false );
    }
    else if( ( irq & LR20XX_SYSTEM_IRQ_RX_DONE ) != 0 )
    {
        rx_drain_packet( true );
    }

    if( ( irq & LR20XX_SYSTEM_IRQ_TIMEOUT ) != 0 )
    {
        // Should not happen in continuous mode: re-arm anyway
        flrc.stats.rx_timeouts += 1;
        ral_lr20xx_set_rx( flrc.radio, RAL_RX_TIMEOUT_CONTINUOUS_MODE );
    }
}

static void tx_load_payload( uint32_t seq )
{
    // Header: time left in this SPEED phase, flagged during the last CONFIG_APP_SWITCH_WARN_MS
    const int32_t left_ms  = ( int32_t ) ( flrc.switch_at_ms - k_uptime_get_32( ) );
    const bool    flag     = ( left_ms <= CONFIG_APP_SWITCH_WARN_MS );
    const uint16_t left_16 = ( uint16_t ) CLAMP( left_ms, 0, UINT16_MAX );

    ( void ) memcpy( flrc.tx_payload + SEQ_OFFSET, &seq, SEQ_SIZE );
    flrc.tx_payload[FLAGS_OFFSET] = flag ? APP_FLRC_FLAG_SWITCH : 0;
    ( void ) memcpy( flrc.tx_payload + SWITCH_MS_OFFSET, &left_16, sizeof( left_16 ) );
    flrc.tx_payload[CYCLE_OFFSET] = flrc.cycle;
    lr20xx_radio_fifo_write_tx( flrc.radio, flrc.tx_payload, APP_FLRC_PAYLOAD_SIZE );
}

static void rx_drain_packet( bool crc_ok )
{
    uint16_t pkt_len = 0;
    uint16_t level   = 0;

    lr20xx_radio_common_get_rx_packet_length( flrc.radio, &pkt_len );
    lr20xx_radio_fifo_get_rx_level( flrc.radio, &level );

    if( ( pkt_len == 0 ) || ( pkt_len > level ) || ( pkt_len > sizeof( flrc.rx_payload ) ) )
    {
        // FIFO out of step (bad length / overflow): drop everything and resync on the next packet.
        // Clearing may cut a packet being received right now; it then shows up as one lost packet.
        lr20xx_radio_fifo_clear_rx( flrc.radio );
        flrc.stats.fifo_resets += 1;
        return;
    }

    lr20xx_radio_fifo_read_rx( flrc.radio, flrc.rx_payload, pkt_len );

    if( crc_ok && ( pkt_len >= SEQ_SIZE ) )
    {
        ral_flrc_rx_pkt_status_t pkt_status = { 0 };
        ral_lr20xx_get_flrc_rx_pkt_status( flrc.radio, &pkt_status );

        uint32_t seq = 0;
        ( void ) memcpy( &seq, flrc.rx_payload + SEQ_OFFSET, SEQ_SIZE );
        rx_account_packet( seq, pkt_len, pkt_status.rssi_sync_in_dbm );
        if( pkt_len >= APP_FLRC_HDR_SIZE )
        {
            rx_check_switch_flag( );
        }
    }
}

static void rx_account_packet( uint32_t seq, uint16_t size, int16_t rssi )
{
    if( flrc.rx_synced == false )
    {
        flrc.stats.rx_expected += 1;
    }
    else
    {
        // Signed difference handles 32-bit wrap
        const int32_t gap = ( int32_t ) ( seq - flrc.rx_seq );

        if( ( gap > 0 ) && ( gap <= CONFIG_APP_SEQ_RESYNC_GAP ) )
        {
            // gap - 1 packets were lost (bad CRC or missed)
            flrc.stats.rx_expected += ( uint32_t ) gap;
        }
        else
        {
            // Backward jump or huge jump: TX restarted. Re-sync without counting losses.
            flrc.stats.rx_expected += 1;
            flrc.stats.resyncs += 1;
        }
    }

    flrc.rx_synced = true;
    flrc.rx_seq    = seq;

    flrc.stats.rx_ok += 1;
    flrc.stats.rx_bytes += size;
    flrc.stats.last_seq   = seq;
    flrc.stats.last_rssi  = rssi;
    flrc.stats.rssi_valid = true;
    flrc.last_rx_ms       = k_uptime_get_32( );
}

/* RX: TX announced the end of its SPEED phase. Keep the latest estimate; wake the main thread once. */
static void rx_check_switch_flag( void )
{
    if( ( flrc.rx_payload[FLAGS_OFFSET] & APP_FLRC_FLAG_SWITCH ) == 0 )
    {
        return;
    }

    uint16_t left_ms = 0;
    ( void ) memcpy( &left_ms, flrc.rx_payload + SWITCH_MS_OFFSET, sizeof( left_ms ) );

    flrc.notice_at_ms = k_uptime_get_32( ) + left_ms;
    flrc.notice_cycle = flrc.rx_payload[CYCLE_OFFSET];
    if( !flrc.notice_valid )
    {
        flrc.notice_valid = true;
        app_event_signal( );
    }
}

/* --- EOF ------------------------------------------------------------------ */
```

## src/app_radio_limits.h
```c
/*
 * SPDX-License-Identifier: MIT
 *
 * Compile-time and run-time guards for the bench rules: transmit only in the 2.4 GHz ISM band
 * (2400-2483.5 MHz) and at most +12 dBm (LR2021 HF PA limit). The sub-GHz antenna on these
 * boards is a CN490 part, so a sub-GHz frequency must never reach the radio.
 */

#ifndef APP_RADIO_LIMITS_H
#define APP_RADIO_LIMITS_H

#include <stdint.h>

#include <zephyr/sys/util.h>
#include <zephyr/toolchain.h>

#include "smtc_modem_hal.h"

#define APP_ISM_2G4_MIN_HZ ( 2400000000ULL )
#define APP_ISM_2G4_MAX_HZ ( 2483500000ULL )

/* Widest signal used here: LoRa 812 kHz (+/- 406 kHz). FLRC 2.6 Mbps occupies about 2.7 MHz (+/- 1.35 MHz). */
#define APP_ISM_EDGE_MARGIN_HZ ( 1400000ULL )

/*!
 * @brief True when a channel centred on f_hz stays inside the 2.4 GHz ISM band
 */
#define APP_FREQ_IN_ISM_2G4( f_hz )                                      \
    ( ( ( uint64_t ) ( f_hz ) >= APP_ISM_2G4_MIN_HZ + APP_ISM_EDGE_MARGIN_HZ ) && \
      ( ( uint64_t ) ( f_hz ) <= APP_ISM_2G4_MAX_HZ - APP_ISM_EDGE_MARGIN_HZ ) )

/*!
 * @brief Compile-time check of one frequency (use at file scope)
 */
#define APP_ASSERT_FREQ_IN_ISM_2G4( f_hz ) \
    BUILD_ASSERT( APP_FREQ_IN_ISM_2G4( f_hz ), "frequency outside the 2.4 GHz ISM band (2400-2483.5 MHz)" )

#define APP_TX_POWER_MAX_DBM ( 12 )

BUILD_ASSERT( CONFIG_APP_TX_POWER_DBM <= APP_TX_POWER_MAX_DBM, "TX power above the +12 dBm HF PA limit" );

/*!
 * @brief Run-time guard, called right before a frequency is handed to the radio
 */
static inline void app_radio_check_freq( uint32_t f_hz )
{
    SMTC_MODEM_HAL_PANIC_ON_FAILURE( APP_FREQ_IN_ISM_2G4( f_hz ) );
}

#endif  // APP_RADIO_LIMITS_H
```
